## arch/arm/mach-rk30/Kconfig
```kconfig
if ARCH_RK30

choice
	prompt "RK3066-tena-dg08 Projects Choose "
	default IMT_RK3066_DEFAULT
	help
		choose kernel for specific project

config IMT_RK3066_DEFAULT
  	bool "project: rk3066 default"
	help	 
	   kernel for rk3066 default

config IMT_RK3066_DG08
  	bool "project: rk3066 tena dg08"
	help	 
	   kernel for tena dg08
	
config IMT_RK3066_MEDIALINK
  	bool "project: rk3066 medialink"
	help	 
	   kernel for medialink

config TN_RK3066_BX05
  	bool "project: rk3066 tena bx05"
	help	 
	   kernel for tena bx05

config TN_RK3066_BX07
  	bool "project: rk3066 tena bx07"
	help	 
	   kernel for tena bx07

endchoice



choice
	prompt "RK30xx Board Type"
	default MACH_RK30_SDK

config MACH_RK30_SDK
	bool "RK30 SDK board"

config MACH_RK3066_SDK
	bool "RK3066 SDK board"

config MACH_RK30_PHONE
	bool "RK30 smart phone board"
	
##$_rbox_$_modify_begin
config MACH_RK30_BOX
	bool "RK30 itv box hamburger board"
	
config MACH_RK30_BOX_PIZZA
	bool "RK30 itv box pizza board"
	
config MACH_RK30_BOX_HOTDOG
	bool "RK30 itv box hotdog board"
		
##$_rbox_$_modify_end

config MACH_RK30_PHONE_LOQUAT
	bool "RK30 smart phone loquat board"

config MACH_RK30_PHONE_A22
        bool "RK30 smart phone a22 board"
	
endchoice

endif
```

## drivers/input/Memsart/Kconfig
```kconfig
#
# gsensor drivers configuration
#

menuconfig Memsart_DEVICE
	bool "Memsart DEVICE support"
	default n	
	help
	  Memsart Virtual Sensor Release Note

if Memsart_DEVICE

config Memsart_VSRN
  bool "Memsart_VSRN"
	depends on Memsart_DEVICE
	default y
	help	 
	  Memsart Virtual Sensor Release Note
endif
```

## drivers/input/imt/Kconfig
```kconfig
#
# gsensor drivers configuration
#

menuconfig IMT_DEVICE
	bool "IMT device support"
	default y	
	help
	  Enable this to be able to choose the drivers for controlling the
	  g_sensor on some platforms, for example on PDAs.

if IMT_DEVICE

config SC_CK235
  bool "SC_CK235"
	depends on IMT_DEVICE
	default y
	help	 
	  To have support for your specific gsesnor you will have to
	  select the proper drivers which depend on this option.
endif
```
